## espressif/2_software/ESP32/espidf5/uart2mqtt/sdkconfig.defaults
```kconfig
#
# ESP-MQTT Configurations
#
CONFIG_MQTT_PROTOCOL_5=y

CONFIG_ESP_WIFI_SSID=""
CONFIG_ESP_WIFI_PASSWORD=""
CONFIG_MQTT_BROKER=""
```
