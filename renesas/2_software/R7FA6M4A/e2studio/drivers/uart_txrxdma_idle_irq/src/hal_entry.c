#include "hal_data.h"

FSP_CPP_HEADER
void R_BSP_WarmStart(bsp_warm_start_event_t event);
FSP_CPP_FOOTER

uint8_t rx_buf[256];

fsp_err_t R_SCI_UART_Write_DMA (uart_ctrl_t * const p_api_ctrl, uint8_t const * const p_src, uint16_t const bytes);
fsp_err_t R_SCI_UART_Read_DMA (uart_ctrl_t * const p_api_ctrl, uint8_t const * const p_dest, uint16_t const bytes);

/*******************************************************************************************************************//**
 * main() is generated by the RA Configuration editor and is used to generate threads if an RTOS is used.  This function
 * is called by main() when no RTOS is used.
 **********************************************************************************************************************/
void hal_entry(void)
{
    fsp_err_t err = FSP_SUCCESS;

#if 0//use api
    err = R_SCI_UART_Open (&g_uart7_ctrl, &g_uart7_cfg);
    assert(FSP_SUCCESS == err);
#else//use g_uart7 handler
    g_uart7.p_api->open(g_uart7.p_ctrl, g_uart7.p_cfg);
    assert(FSP_SUCCESS == err);
#endif

    g_timer0.p_api->open(g_timer0.p_ctrl, g_timer0.p_cfg);
    g_timer0.p_api->enable(g_timer0.p_ctrl);

    g_elc.p_api->open(g_elc.p_ctrl, g_elc.p_cfg);
    g_elc.p_api->enable(g_elc.p_ctrl);

    // dma init
    err = g_transfer_on_dmac.open(g_transfer_dmac_sci7_tx.p_ctrl, g_transfer_dmac_sci7_tx.p_cfg);
    assert(FSP_SUCCESS == err);
    err = g_transfer_on_dmac.enable(g_transfer_dmac_sci7_tx.p_ctrl);
    assert(FSP_SUCCESS == err);
    err = g_transfer_on_dmac.open(g_transfer_dmac_sci7_rx.p_ctrl, g_transfer_dmac_sci7_rx.p_cfg);
    assert(FSP_SUCCESS == err);
    err = g_transfer_on_dmac.enable(g_transfer_dmac_sci7_rx.p_ctrl);
    assert(FSP_SUCCESS == err);

    // dma tx
    const char* test = "hello world";
    R_SCI_UART_Write_DMA(g_uart7.p_ctrl, (uint8_t *)test, (uint16_t)strlen(test));

    // dma rx
    R_SCI_UART_Read_DMA(g_uart7.p_ctrl, rx_buf, sizeof(rx_buf));

    while(1);

#if BSP_TZ_SECURE_BUILD
    /* Enter non-secure code */
    R_BSP_NonSecureEnter();
#endif
}

/*******************************************************************************************************************//**
 * This function is called at various points during the startup process.  This implementation uses the event that is
 * called right before main() to set up the pins.
 *
 * @param[in]  event    Where at in the start up process the code is currently at
 **********************************************************************************************************************/
void R_BSP_WarmStart(bsp_warm_start_event_t event)
{
    if (BSP_WARM_START_RESET == event)
    {
#if BSP_FEATURE_FLASH_LP_VERSION != 0

        /* Enable reading from data flash. */
        R_FACI_LP->DFLCTL = 1U;

        /* Would normally have to wait tDSTOP(6us) for data flash recovery. Placing the enable here, before clock and
         * C runtime initialization, should negate the need for a delay since the initialization will typically take more than 6us. */
#endif
    }

    if (BSP_WARM_START_POST_C == event)
    {
        /* C runtime environment and system clocks are setup. */

        /* Configure pins. */
        R_IOPORT_Open (&IOPORT_CFG_CTRL, &IOPORT_CFG_NAME);

#if BSP_CFG_SDRAM_ENABLED

        /* Setup SDRAM and initialize it. Must configure pins first. */
        R_BSP_SdramInit(true);
#endif
    }
}

#if BSP_TZ_SECURE_BUILD

FSP_CPP_HEADER
BSP_CMSE_NONSECURE_ENTRY void template_nonsecure_callable ();

/* Trustzone Secure Projects require at least one nonsecure callable function in order to build (Remove this if it is not required to build). */
BSP_CMSE_NONSECURE_ENTRY void template_nonsecure_callable ()
{

}
FSP_CPP_FOOTER

#endif

fsp_err_t R_SCI_UART_Write_DMA (uart_ctrl_t * const p_api_ctrl, uint8_t const * const p_src, uint16_t const bytes)
{
    /* SCI SCR register bit masks */
    #define SCI_SCR_TEIE_MASK                       (0x04U) ///< Transmit End Interrupt Enable
    #define SCI_SCR_RE_MASK                         (0x10U) ///< Receive Enable
    #define SCI_SCR_TE_MASK                         (0x20U) ///< Transmit Enable
    #define SCI_SCR_RIE_MASK                        (0x40U) ///< Receive Interrupt Enable
    #define SCI_SCR_TIE_MASK                        (0x80U) ///< Transmit Interrupt Enable

    fsp_err_t err = FSP_SUCCESS;

    sci_uart_instance_ctrl_t * p_ctrl = (sci_uart_instance_ctrl_t *) p_api_ctrl;

    //Before initiating DMA transfer, must be clear it first.
    R_ICU->IELSR[SCI7_TXI_IRQn] = 0U;

    /* Transmit interrupts must be disabled to start with. */
    p_ctrl->p_reg->SCR &= (uint8_t) ~(SCI_SCR_TIE_MASK | SCI_SCR_TE_MASK);

    //dma config
    g_transfer_dmac_sci7_tx.p_cfg->p_info->p_src = (void*)&p_src[0];
    g_transfer_dmac_sci7_tx.p_cfg->p_info->p_dest = (void*)&R_SCI7->TDR;
    g_transfer_dmac_sci7_tx.p_cfg->p_info->length = bytes;

    err = g_transfer_dmac_sci7_tx.p_api->reconfigure(g_transfer_dmac_sci7_tx.p_ctrl, g_transfer_dmac_sci7_tx.p_cfg->p_info);

    /* Trigger a TXI interrupt. This triggers the transfer instance or a TXI interrupt if the transfer instance is
         * not used. */
    p_ctrl->p_reg->SCR |= (SCI_SCR_TIE_MASK | SCI_SCR_TE_MASK);

    return err;

}

fsp_err_t R_SCI_UART_Read_DMA (uart_ctrl_t * const p_api_ctrl, uint8_t const * const p_dest, uint16_t const bytes)
{
    /* SCI SCR register bit masks */
    #define SCI_SCR_TEIE_MASK                       (0x04U) ///< Transmit End Interrupt Enable
    #define SCI_SCR_RE_MASK                         (0x10U) ///< Receive Enable
    #define SCI_SCR_TE_MASK                         (0x20U) ///< Transmit Enable
    #define SCI_SCR_RIE_MASK                        (0x40U) ///< Receive Interrupt Enable
    #define SCI_SCR_TIE_MASK                        (0x80U) ///< Transmit Interrupt Enable

    fsp_err_t err = FSP_SUCCESS;

    sci_uart_instance_ctrl_t * p_ctrl = (sci_uart_instance_ctrl_t *) p_api_ctrl;

    //Before initiating DMA transfer, must be clear it first.
    R_ICU->IELSR[SCI7_RXI_IRQn] = 0U;

    /* Transmit interrupts must be disabled to start with. */
    p_ctrl->p_reg->SCR &= (uint8_t) ~(SCI_SCR_RIE_MASK | SCI_SCR_RE_MASK);

    // dma config
    g_transfer_dmac_sci7_rx.p_cfg->p_info->p_src = (void*)&R_SCI7->RDR;
    g_transfer_dmac_sci7_rx.p_cfg->p_info->p_dest = (void*)&p_dest[0];
    g_transfer_dmac_sci7_rx.p_cfg->p_info->length = bytes;

    err = g_transfer_dmac_sci7_rx.p_api->reconfigure(g_transfer_dmac_sci7_rx.p_ctrl, g_transfer_dmac_sci7_rx.p_cfg->p_info);

    /* Trigger a TXI interrupt. This triggers the transfer instance or a TXI interrupt if the transfer instance is
         * not used. */
    p_ctrl->p_reg->SCR |= (SCI_SCR_RIE_MASK | SCI_SCR_RE_MASK);

    return err;

}

void g_timer0_callback(timer_callback_args_t *p_args)
{
    if(p_args->event == TIMER_EVENT_CYCLE_END)
    {
        transfer_properties_t p_info;

        R_DMAC_InfoGet(g_transfer_dmac_sci7_rx.p_ctrl, &p_info);

        R_SCI_UART_Write_DMA(g_uart7.p_ctrl, rx_buf, (uint16_t)(sizeof(rx_buf) - p_info.transfer_length_remaining));

        R_SCI_UART_Read_DMA(g_uart7.p_ctrl, rx_buf, sizeof(rx_buf));
    }

}

void dmac_sci7_tx_callback(transfer_callback_args_t *p_args)
{
    (void) p_args;
}

void dmac_sci7_rx_callback(transfer_callback_args_t *p_args)
{
    (void) p_args;
}
