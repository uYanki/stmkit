#include "hal_data.h"

FSP_CPP_HEADER
void R_BSP_WarmStart(bsp_warm_start_event_t event);
FSP_CPP_FOOTER

/* Global variables for the USB */
usb_status_t usb_event;
usb_setup_t usb_setup;
uint8_t g_usb_module_number = 0x00;
usb_class_t g_usb_class_type = 0x00;

/* Global variables for the program */
static char send_str[12] = { "LED on\n\r" };
static volatile uint8_t sw1_pressed = false;
static uint8_t led_level = BSP_IO_LEVEL_HIGH;

#define LINE_CODING_LENGTH (0x07U)

/*******************************************************************************************************************//**
 * main() is generated by the RA Configuration editor and is used to generate threads if an RTOS is used.  This function
 * is called by main() when no RTOS is used.
 **********************************************************************************************************************/
void hal_entry(void)
{
    static usb_pcdc_linecoding_t g_line_coding;

    g_external_irq00.p_api->open (g_external_irq00.p_ctrl, g_external_irq00.p_cfg);
    g_external_irq00.p_api->enable (g_external_irq00.p_ctrl);

    R_USB_Open (&g_basic0_ctrl, &g_basic0_cfg);
    R_USB_ClassTypeGet (&g_basic0_ctrl, &g_usb_class_type);
    R_USB_ModuleNumberGet (&g_basic0_ctrl, &g_usb_module_number);

    while(1){
        /* Obtain USB related events */
        R_USB_EventGet (&g_basic0_ctrl, &usb_event);
        /* USB event received by R_USB_EventGet */
        if (usb_event == USB_STATUS_REQUEST)
        {
            R_USB_SetupGet (&g_basic0_ctrl, &usb_setup);
            if (USB_PCDC_SET_LINE_CODING == (usb_setup.request_type & USB_BREQUEST))
            {
            /* Configure virtual UART settings */
                R_USB_PeriControlDataGet (&g_basic0_ctrl, (uint8_t*) &g_line_coding, LINE_CODING_LENGTH);
            }
            else if (USB_PCDC_GET_LINE_CODING == (usb_setup.request_type & USB_BREQUEST))
            {
            /* Send virtual UART settings back to host */
                R_USB_PeriControlDataSet (&g_basic0_ctrl, (uint8_t*) &g_line_coding, LINE_CODING_LENGTH);
            }
            else if (USB_PCDC_SET_CONTROL_LINE_STATE == (usb_setup.request_type & USB_BREQUEST))
            {
                /* Acknowledge all other status requests */
                R_USB_PeriControlStatusSet (&g_basic0_ctrl,
                USB_SETUP_STATUS_ACK);
            }
            else
            {
            }
        }

        if (sw1_pressed == true)
        {
            sw1_pressed = false;
            if (led_level == BSP_IO_LEVEL_HIGH)
            {
                strcpy (send_str, "LED off\n\r");
                led_level = BSP_IO_LEVEL_LOW;
            }
            else
            {
                strcpy (send_str, "LED on\n\r");
                led_level = BSP_IO_LEVEL_HIGH;
            }
        }

    }

#if BSP_TZ_SECURE_BUILD
    /* Enter non-secure code */
    R_BSP_NonSecureEnter();
#endif
}

/*******************************************************************************************************************//**
 * This function is called at various points during the startup process.  This implementation uses the event that is
 * called right before main() to set up the pins.
 *
 * @param[in]  event    Where at in the start up process the code is currently at
 **********************************************************************************************************************/
void R_BSP_WarmStart(bsp_warm_start_event_t event)
{
    if (BSP_WARM_START_RESET == event)
    {
#if BSP_FEATURE_FLASH_LP_VERSION != 0

        /* Enable reading from data flash. */
        R_FACI_LP->DFLCTL = 1U;

        /* Would normally have to wait tDSTOP(6us) for data flash recovery. Placing the enable here, before clock and
         * C runtime initialization, should negate the need for a delay since the initialization will typically take more than 6us. */
#endif
    }

    if (BSP_WARM_START_POST_C == event)
    {
        /* C runtime environment and system clocks are setup. */

        /* Configure pins. */
        R_IOPORT_Open (&g_ioport_ctrl, &g_bsp_pin_cfg);
    }
}

#if BSP_TZ_SECURE_BUILD

BSP_CMSE_NONSECURE_ENTRY void template_nonsecure_callable ();

/* Trustzone Secure Projects require at least one nonsecure callable function in order to build (Remove this if it is not required to build). */
BSP_CMSE_NONSECURE_ENTRY void template_nonsecure_callable ()
{

}
#endif


void external_irq00_callback(external_irq_callback_args_t *p_args)
{
    FSP_PARAMETER_NOT_USED(p_args);
    extern bsp_leds_t g_bsp_leds;
    bsp_leds_t Leds = g_bsp_leds;
    sw1_pressed = true;
    g_ioport.p_api->pinWrite (&g_ioport_ctrl, Leds.p_leds[BSP_LED_LED3],
    led_level);
    R_USB_Write (&g_basic0_ctrl, (uint8_t*) send_str, ((uint32_t) strlen (send_str)), (uint8_t) g_usb_class_type);
}
